## zephyr/drivers/input/Kconfig
```kconfig
# Copyright (c) 2026 Bert Outtier <outtierbert@gmail.com>
# SPDX-License-Identifier: Apache-2.0

if INPUT

config INPUT_FRI3D_COMMUNICATOR
	bool "Fri3d Camp 2026 communicator keyboard"
	default y
	depends on DT_HAS_FRI3D_COMMUNICATOR_2026_INPUT_ENABLED
	depends on MFD_FRI3D_COMMUNICATOR
	help
	  The keyboard of the Fri3d Camp 2026 communicator add-on as input
	  events (Zephyr key codes).

config INPUT_FRI3D_COMMUNICATOR_INIT_PRIORITY
	int "Initialization priority"
	default INPUT_INIT_PRIORITY
	depends on INPUT_FRI3D_COMMUNICATOR
	help
	  After the communicator's MFD (MFD_FRI3D_COMMUNICATOR_INIT_PRIORITY).

endif # INPUT
```

## zephyr/drivers/mfd/Kconfig
```kconfig
# Copyright (c) 2026 Bert Outtier <outtierbert@gmail.com>
# SPDX-License-Identifier: Apache-2.0

if MFD

config MFD_FRI3D_COMMUNICATOR
	bool "Fri3d Camp 2026 communicator add-on"
	default y
	depends on DT_HAS_FRI3D_COMMUNICATOR_2026_ENABLED
	depends on MULTITHREADING # the MFD uses work items and a message queue
	select I2C
	select UART_INTERRUPT_DRIVEN if $(dt_compat_any_has_prop,$(DT_COMPAT_FRI3D_COMMUNICATOR_2026),uart)
	help
	  Multi-function device driver for the CH32X035 keyboard controller of
	  the Fri3d Camp 2026 communicator add-on on the expansion connector:
	  its registers over I2C (version, configuration, backlight) and the
	  HID key reports it sends on its UART.

if MFD_FRI3D_COMMUNICATOR

config MFD_FRI3D_COMMUNICATOR_INIT_PRIORITY
	int "Initialization priority"
	default MFD_INIT_PRIORITY
	help
	  Must be after the I2C controller and the UART.

config MFD_FRI3D_COMMUNICATOR_UPDATE
	bool "Communicator firmware update over RVSWD"
	help
	  Update the keyboard controller's firmware with
	  mfd_fri3d_communicator_update(), through the RVSWD interface of the
	  communicator's rvswd property: the firmware gives its I2C pins to SWD
	  on request (the remap bit of its configuration register). Needs the
	  zephyr-rvswd module (github.com/bertouttier/zephyr-rvswd) in the west
	  workspace and an enabled wch,rvswd node as the communicator's rvswd
	  property (<fri3d/communicator.dtsi> has it); the build stops if either
	  is missing.

if MFD_FRI3D_COMMUNICATOR_UPDATE

config MFD_FRI3D_COMMUNICATOR_FIRMWARE
	string "Communicator firmware image to bundle"
	help
	  Path to a communicator firmware binary (communicator_2026 release
	  build), absolute or relative to the application directory, to link
	  into the application. Empty: no image. With an image, the
	  "communicator update" shell command installs it.

config MFD_FRI3D_COMMUNICATOR_FIRMWARE_VERSION
	string "Version of the bundled firmware image"
	default "0.0.0"
	help
	  Version of the image in MFD_FRI3D_COMMUNICATOR_FIRMWARE, as
	  major.minor.patch.

config MFD_FRI3D_COMMUNICATOR_UPDATE_AT_BOOT
	bool "Install the bundled image at boot when the add-on runs an older version"
	help
	  At init, if the add-on reports an older version than
	  MFD_FRI3D_COMMUNICATOR_FIRMWARE_VERSION, or does not answer at all
	  (e.g. no firmware), install the bundled image. Debug builds of the
	  add-on firmware report 255.255.255 and are left alone. Takes about 10
	  seconds during init. The update callbacks
	  (mfd_fri3d_communicator_set_update_callbacks()) must be set before the
	  device initializes. The bundled version must match the image, or the
	  add-on is updated at every start.

endif # MFD_FRI3D_COMMUNICATOR_UPDATE

endif # MFD_FRI3D_COMMUNICATOR

endif # MFD
```

## zephyr/dts/bindings/input/fri3d,communicator-2026-input.yaml
```yaml
# Copyright (c) 2026 Bert Outtier <outtierbert@gmail.com>
# SPDX-License-Identifier: Apache-2.0

description: |
  Keyboard of the Fri3d Camp 2026 communicator add-on as input events: every
  key of its key matrix (read over I2C by the communicator's MFD, firmware
  v1.1.0 and later) as INPUT_EV_KEY with the Zephyr key code of the keymap,
  1 for a press and 0 for a release. The changes of one matrix read form one
  group (the sync flag on the last). A child node of the
  fri3d,communicator-2026 node, see <fri3d/communicator.dtsi>.

  The Fn key is INPUT_KEY_RIGHTMETA, as in the add-on's firmware; its Fn
  layer (Delete, Home, End, Page Up/Down, Caps Lock) is the application's
  business here. Keys on more than one switch (the space bar) are reported
  once.

compatible: "fri3d,communicator-2026-input"

include: base.yaml

properties:
  keymap:
    type: array
    required: true
    description: |
      Zephyr key code of every key, using the MATRIX_KEY(row, col, code)
      macro of <zephyr/dt-bindings/input/keymap.h>: row 0-7 (the bit), column
      0-8 (the byte of the matrix register).
```

## zephyr/dts/bindings/mfd/fri3d,communicator-2026.yaml
```yaml
# Copyright (c) 2026 Bert Outtier <outtierbert@gmail.com>
# SPDX-License-Identifier: Apache-2.0

description: |
  CH32X035 keyboard controller of the Fri3d Camp 2026 communicator add-on,
  running the communicator_2026 firmware as an I2C slave (address 0x39) on
  the badge's expansion connector.

  Over I2C it has its firmware version, the current HID key report, a
  configuration register (reboot to the bootloader, firmware remap to SWD,
  speaker amplifier shutdown) and the keyboard backlight. On its UART (115200
  baud) it sends the 8-byte HID key report on every change; the driver hands
  those to a callback. The add-on's speaker amplifier and microphone sit on
  the badge's I2S and are not part of this device; the amplifier's shutdown
  input is the configuration bit. Needs firmware v1.0.3 or later.

    &i2c0 {
        communicator: communicator@39 {
            compatible = "fri3d,communicator-2026";
            reg = <0x39>;
            uart = <&uart0>;
        };
    };

compatible: "fri3d,communicator-2026"

include: i2c-device.yaml

properties:
  uart:
    type: phandle
    description: |
      UART that receives the add-on's HID key reports (115200 baud, expansion
      connector pin 3, badge IO44): data there triggers a read of the report
      over I2C. Without it there are no key reports.

  rvswd:
    type: phandle
    description: |
      RVSWD interface (wch,rvswd) on the add-on's I2C pins (the expansion I2C
      bus), to update its firmware (CONFIG_MFD_FRI3D_COMMUNICATOR_UPDATE).

  poll-period-ms:
    type: int
    default: 10
    description: |
      Shortest time between two I2C reads of the key report. The add-on
      sends its report on the UART (8 bytes, 0.7 ms) on every change; the
      driver reads the report when UART data arrives, at most this often.

  boot-timeout-ms:
    type: int
    default: 1500
    description: |
      Time to wait for the add-on to answer on I2C at init, after it powers
      up with the badge.
```
